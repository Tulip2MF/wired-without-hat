/*
 * Copyright (c) 2020 Pete Johanson
 *
 * SPDX-License-Identifier: MIT
 */

#include "dactyl.dtsi"

&default_transform {
	col-offset = <5>;
};

&kscan0 {
	col-gpios
		= <&pro_micro0  17 GPIO_ACTIVE_HIGH>
		, <&pro_micro0  20 GPIO_ACTIVE_HIGH>
		, <&pro_micro0  24 GPIO_ACTIVE_HIGH>
		, <&pro_micro0 11 GPIO_ACTIVE_HIGH>
		, <&pro_micro1 06 GPIO_ACTIVE_HIGH>
		;
};
