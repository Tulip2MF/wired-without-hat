/*
 * Copyright (c) 2020 Pete Johanson
 *
 * SPDX-License-Identifier: MIT
 */

#include "dactyl.dtsi"

&kscan0 {
	col-gpios
		= <&pro_micro  2 GPIO_ACTIVE_HIGH>
		, <&pro_micro  3 GPIO_ACTIVE_HIGH>
		, <&pro_micro  5 GPIO_ACTIVE_HIGH>
		, <&pro_micro 7 GPIO_ACTIVE_HIGH>
		, <&pro_micro 9 GPIO_ACTIVE_HIGH>
		;
};
